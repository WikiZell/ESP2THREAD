## components/thread_border_router/Kconfig.projbuild
```kconfig
menu "ESP2THREAD Border Router"

    config ESP_BR_BOARD_STANDALONE
        bool "Standalone ESP2THREAD board"
        default y

    config OPENTHREAD_BR_AUTO_START
        bool "Start Wi-Fi and the border-router services automatically"
        default y
        help
            Connect the Wi-Fi backbone automatically. A saved Thread dataset
            is started, while a fresh board waits for an explicit Create or
            Join choice.

    config OPENTHREAD_BR_START_WEB
        bool "Enable the border-router REST API and web UI"
        select OPENTHREAD_COMMISSIONER
        select OPENTHREAD_JOINER
        default y

    config OPENTHREAD_BR_SOFTAP_SETUP
        bool "Enable first-boot SoftAP Wi-Fi setup"
        default y

endmenu
```

## sdkconfig.defaults
```kconfig
# Target and 4 MB flash
CONFIG_IDF_TARGET="esp32c6"
CONFIG_ESPTOOLPY_FLASHSIZE_4MB=y
CONFIG_ESPTOOLPY_FLASHSIZE="4MB"

# Custom rollback-capable partition table
CONFIG_PARTITION_TABLE_CUSTOM=y
CONFIG_PARTITION_TABLE_CUSTOM_FILENAME="partitions.csv"
CONFIG_PARTITION_TABLE_FILENAME="partitions.csv"
CONFIG_PARTITION_TABLE_OFFSET=0x8000
CONFIG_PARTITION_TABLE_MD5=y

# Keep the image compact enough for two OTA slots.
CONFIG_COMPILER_OPTIMIZATION_SIZE=y
CONFIG_LIBC_NEWLIB_NANO_FORMAT=y

# Native USB console on the XIAO ESP32-C6.
CONFIG_ESP_CONSOLE_USB_SERIAL_JTAG=y
CONFIG_ESP_CONSOLE_SECONDARY_NONE=y

# Wi-Fi backbone link.
CONFIG_EXAMPLE_CONNECT_WIFI=y
CONFIG_EXAMPLE_CONNECT_ETHERNET=n
CONFIG_ESP_WIFI_SOFTAP_SUPPORT=y

# OpenThread full-device border router using the C6's native 802.15.4 radio.
CONFIG_OPENTHREAD_ENABLED=y
CONFIG_OPENTHREAD_BORDER_ROUTER=y
CONFIG_OPENTHREAD_RADIO_NATIVE=y
CONFIG_OPENTHREAD_RADIO_SPINEL_UART=n
CONFIG_OPENTHREAD_RADIO_SPINEL_SPI=n
CONFIG_OPENTHREAD_FTD=y
CONFIG_OPENTHREAD_CLI=y
CONFIG_OPENTHREAD_CLI_ESP_EXTENSION=y
CONFIG_OPENTHREAD_COMMISSIONER=y
CONFIG_OPENTHREAD_JOINER=y
CONFIG_OPENTHREAD_TASK_SIZE=8192

# Single-chip Wi-Fi/IEEE 802.15.4 coexistence. This is required on ESP32-C6.
CONFIG_ESP_COEX_SW_COEXIST_ENABLE=y

# ESP2THREAD appliance behavior.
CONFIG_ESP_BR_BOARD_STANDALONE=y
CONFIG_OPENTHREAD_BR_AUTO_START=y
CONFIG_OPENTHREAD_BR_START_WEB=y
CONFIG_OPENTHREAD_BR_SOFTAP_SETUP=y
CONFIG_AUTO_UPDATE_RCP=n
CONFIG_OPENTHREAD_CLI_OTA=n
CONFIG_OPENTHREAD_RCP_COMMAND=n

# IPv6 border routing and service discovery.
CONFIG_LWIP_IPV6_FORWARD=y
CONFIG_LWIP_IPV6_NUM_ADDRESSES=12
CONFIG_LWIP_MULTICAST_PING=y
CONFIG_LWIP_NETIF_STATUS_CALLBACK=y
CONFIG_LWIP_HOOK_IP6_ROUTE_DEFAULT=y
CONFIG_LWIP_HOOK_ND6_GET_GW_DEFAULT=y
CONFIG_LWIP_HOOK_IP6_INPUT_CUSTOM=y
CONFIG_LWIP_HOOK_IP6_SELECT_SRC_ADDR_CUSTOM=y
CONFIG_LWIP_IPV6_AUTOCONFIG=y
CONFIG_LWIP_FORCE_ROUTER_FORWARDING=y
CONFIG_MDNS_MULTIPLE_INSTANCE=y
CONFIG_MDNS_MAX_SERVICES=200

# TLS features required by OpenThread commissioning.
CONFIG_MBEDTLS_CMAC_C=y
CONFIG_MBEDTLS_SSL_PROTO_DTLS=y
CONFIG_MBEDTLS_KEY_EXCHANGE_ECJPAKE=y
CONFIG_MBEDTLS_ECJPAKE_C=y

# Runtime sizing.
CONFIG_ESP_SYSTEM_EVENT_TASK_STACK_SIZE=3584
CONFIG_ESP_MAIN_TASK_STACK_SIZE=6144
CONFIG_HTTPD_MAX_REQ_HDR_LEN=1024
```
